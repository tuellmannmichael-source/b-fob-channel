## CMakeLists.txt
```
cmake_minimum_required(VERSION 3.20.0)

find_package(Zephyr REQUIRED HINTS $ENV{ZEPHYR_BASE})
project(ble_triangulation_receiver)

target_sources(app PRIVATE
    src/main.c
    src/ble/ble_manager.c
    src/ble/cs_adapter.c
    src/ble/cs_estimator.c
    src/ble/cs_phase_unwrap.c
    src/triangulation/triangulation.c
    src/triangulation/rssi_filter.c
)

target_include_directories(app PRIVATE
    src
)
```

## Kconfig
```
menu "BLE Triangulation"

config TRIANGULATION_NUM_ANTENNAS
    int "Number of receiver antennas"
    default 3
    range 3 8
    help
      Number of BLE receiver nodes used for trilateration.

config TRIANGULATION_RSSI_REF
    int "Reference RSSI at 1 meter (dBm, negative)"
    default -59
    range -100 -20
    help
      Measured RSSI at 1 meter from the keyfob. Calibrate per-antenna
      for best results.

config TRIANGULATION_PATH_LOSS_EXP_X10
    int "Path-loss exponent * 10 (e.g. 30 = 3.0)"
    default 30
    range 15 60
    help
      Path-loss exponent for the log-distance model, multiplied by 10
      to avoid floating point in Kconfig. A vehicle interior typically
      uses 2.5-3.5 (i.e. 25-35 here).

config TRIANGULATION_KALMAN_Q_X10
    int "Kalman process noise Q * 10"
    default 5
    help
      Process noise for the RSSI Kalman filter. Higher = more responsive.
      Value is divided by 10 at runtime (5 = 0.5).

config TRIANGULATION_KALMAN_R_X10
    int "Kalman measurement noise R * 10"
    default 80
    help
      Measurement noise for the RSSI Kalman filter. Higher = smoother.
      Value is divided by 10 at runtime (80 = 8.0).


config TRIANGULATION_RSSI_FALLBACK_SIGMA_CM
    int "RSSI fallback sigma (cm)"
    default 400
    range 20 2000
    help
      Uncertainty used by weighted trilateration when distance comes from
      RSSI fallback rather than channel sounding.

config BLE_CS_ENABLE
    bool "Enable BLE Channel Sounding integration path"
    default n
    help
      Enables the channel-sounding-ready data path. Current implementation
      keeps RSSI fallback active until controller-specific CS hooks are wired.

config CS_PHASE_SLOPE_OFFSET_MM
    int "Phase slope calibration offset (mm)"
    default 1910
    depends on BLE_CS_ENABLE
    help
      Systematic distance offset of the phase-slope estimator, measured at a
      known reference distance. Subtracted from every estimate. Literature
      reports ~1.91 m typical for BLE CS; measure on your hardware to refine.

config CS_IFFT_OFFSET_MM
    int "IFFT calibration offset (mm)"
    default 460
    depends on BLE_CS_ENABLE
    help
      Systematic distance offset of the IFFT estimator, measured at a known
      reference distance. Subtracted from every estimate. Literature reports
      ~0.46 m typical; measure on your hardware to refine.

config CS_OUTLIER_GATE_SIGMA_X10
    int "Outlier gate width in sigmas * 10 (e.g. 30 = 3.0)"
    default 30
    depends on BLE_CS_ENABLE
    help
      Innovation gate width for the distance Kalman filter. Measurements
      deviating more than this many sigmas from the predicted state are
      flagged as outliers and given elevated uncertainty.

config CS_FUSION_AGREE_MM
    int "Phase-slope / IFFT fusion agreement threshold (mm)"
    default 300
    depends on BLE_CS_ENABLE
    help
      When both estimators agree within this distance, their results are
      averaged with reduced uncertainty. Otherwise only the IFFT result
      (more multipath-robust) is used.

config BLE_RECONNECT_INITIAL_MS
    int "Initial reconnect delay (ms)"
    default 100
    help
      Delay before the first reconnect attempt after a disconnect.

config BLE_RECONNECT_MAX_MS
    int "Maximum reconnect delay (ms)"
    default 3000
    help
      Upper bound for exponential-backoff reconnect delay.

config BLE_CONN_INTERVAL_MS
    int "BLE connection interval (ms)"
    default 100
    range 8 4000
    help
      BLE connection interval in milliseconds. Lower values give faster
      RSSI sampling but increase power consumption.

choice BLE_CS_MEASUREMENT_MODE
    prompt "Connection sampling mode"
    default BLE_CS_MODE_ROTATING
    help
      Select if connection samples are taken with a rotating RF switch
      (A->B->C) or with a fixed single antenna.

config BLE_CS_MODE_ROTATING
    bool "Rotating RF switch (A->B->C)"

config BLE_CS_MODE_SINGLE
    bool "Single-antenna connection sampling"

endchoice

config BLE_CS_SWITCH_SETTLE_US
    int "RF switch settle budget before sample (us)"
    default 150
    range 10 2000

config BLE_CS_SESSION_TIMING_US
    int "Connection-event session overhead (us)"
    default 400
    range 0 4000

config BLE_CS_WATCHDOG_MAX_FAILURES
    int "Per-antenna watchdog threshold (consecutive read failures)"
    default 3
    range 1 20

config BLE_CS_WATCHDOG_COOLDOWN_CYCLES
    int "Per-antenna cooldown cycles after watchdog trip"
    default 6
    range 1 100

config BLE_SUPERVISION_TIMEOUT_MS
    int "BLE supervision timeout (ms)"
    default 4000
    range 100 32000
    help
      Time without successful connection events before the link is
      considered lost.

config BLE_CS_DEGRADE_ERR_THRESHOLD
    int "CS degrade threshold before RSSI fallback"
    default 5
    range 1 100
    help
      Number of consecutive CS failures before the receiver marks CS as
      degraded and falls back to RSSI-only measurements.

config BLE_CS_PROCEDURE_INTERVAL_MS
    int "CS procedure request interval (ms)"
    default 500
    range 100 10000
    depends on BLE_CS_ENABLE
    help
      Interval between Channel Sounding procedure requests. Shorter
      intervals give faster distance updates but consume more airtime.
      Must be larger than the connection interval to avoid scheduling
      collisions.

config BLE_CS_MEDIAN_WINDOW
    int "CS distance median pre-filter window size"
    default 5
    range 3 15
    depends on BLE_CS_ENABLE
    help
      Number of recent CS distance estimates to keep for the running
      median pre-filter before Kalman update. Larger windows smooth
      more but add latency.

config BLE_CS_RTT_GATE_TOLERANCE_MM
    int "RTT plausibility gate tolerance (mm)"
    default 2000
    depends on BLE_CS_ENABLE
    help
      Maximum acceptable difference between PBR distance and RTT distance.
      If the difference exceeds this value, the PBR estimate is discarded
      and RTT is used as fallback.

endmenu

source "Kconfig.zephyr"
```

## prj.conf
```kconfig
# BLE Receiver - Zephyr/nRF Connect SDK Configuration

# System
CONFIG_HEAP_MEM_POOL_SIZE=4096
CONFIG_MAIN_STACK_SIZE=4096

# Logging
CONFIG_LOG=y
CONFIG_LOG_DEFAULT_LEVEL=3

# Bluetooth core
CONFIG_BT=y
CONFIG_BT_CENTRAL=y
CONFIG_BT_OBSERVER=y
CONFIG_BT_GATT_CLIENT=y

# Initial target mode: 1 Receiver <-> 1 Keyfob (P2P ranging)
CONFIG_BT_MAX_CONN=1
CONFIG_BT_MAX_PAIRED=1

# Security / bonding
CONFIG_BT_SMP=y
CONFIG_BT_BONDABLE=y
CONFIG_BT_SETTINGS=y
CONFIG_FLASH=y
CONFIG_FLASH_MAP=y
CONFIG_NVS=y
CONFIG_SETTINGS=y
CONFIG_SETTINGS_NVS=y

# Prefer deterministic connection-based RSSI cadence
CONFIG_BT_CTLR_DATA_LENGTH_MAX=27

# Channel Sounding is not enabled in current NCS baseline (API not app-ready)
# CONFIG_BT_CHANNEL_SOUNDING=y

# Direction Finding (AoA) - optional future mode only
# CONFIG_BT_DF=y
# CONFIG_BT_DF_CONNECTIONLESS_CTE_RX=y
# CONFIG_BT_DF_CONNECTION_CTE_RX=y
# CONFIG_BT_EXT_ADV=y

# UART for inter-node communication (future multi-anchor mode)
CONFIG_SERIAL=y
CONFIG_UART_INTERRUPT_DRIVEN=y

# Float support for trilateration math
CONFIG_FPU=y
CONFIG_NEWLIB_LIBC=y

# Kernel work queue (for reconnect scheduling)
CONFIG_SYSTEM_WORKQUEUE_STACK_SIZE=2048

# Channel Sounding migration path
CONFIG_BLE_CS_ENABLE=n
CONFIG_TRIANGULATION_RSSI_FALLBACK_SIGMA_CM=400
```

## src/main.c
```c
#include <zephyr/kernel.h>
#include <zephyr/logging/log.h>
#include <zephyr/sys/util.h>

#include "ble/ble_manager.h"
#include "triangulation/triangulation.h"
#include "config/app_config.h"

LOG_MODULE_REGISTER(main, LOG_LEVEL_INF);

static triangulation_ctx_t tri_ctx;

/* --------------------------------------------------------------------------
 * Callbacks
 * ----------------------------------------------------------------------- */

/** Called by ble_manager when a local RSSI measurement is available. */
static void on_local_rssi(uint8_t antenna_id, int8_t rssi, int64_t sample_ts_ms)
{
    /*
     * Distance updates are ingested through on_distance().
     * Keep RSSI callback for debug/telemetry visibility.
     */
    ARG_UNUSED(antenna_id);
    ARG_UNUSED(rssi);
    ARG_UNUSED(sample_ts_ms);
}

static void on_distance(uint8_t antenna_id,
                        float distance_m,
                        float sigma_m,
                        enum ble_distance_source source)
{
    enum triangulation_measurement_source tri_source =
        (source == BLE_DISTANCE_SOURCE_CHANNEL_SOUNDING)
            ? TRI_MEAS_SOURCE_CHANNEL_SOUNDING
            : TRI_MEAS_SOURCE_RSSI_FALLBACK;

    triangulation_feed_distance(&tri_ctx,
                                antenna_id,
                                distance_m,
                                sigma_m,
                                tri_source);
}

static void on_ble_state(enum ble_state new_state)
{
    switch (new_state) {
    case BLE_STATE_CONNECTED:
        LOG_INF("Keyfob connected -- ranging active");
        break;
    case BLE_STATE_RECONNECTING:
        LOG_WRN("Keyfob disconnected -- reconnecting");
        break;
    default:
        break;
    }
}

int main(void)
{
    LOG_INF("BLE Triangulation Receiver starting");

    triangulation_init(&tri_ctx);

    int ret = ble_manager_init(on_local_rssi, on_distance, on_ble_state);
    if (ret) {
        LOG_ERR("BLE Manager init failed (err %d)", ret);
        return ret;
    }

    ret = ble_manager_start();
    if (ret) {
        LOG_ERR("BLE Manager start failed (err %d)", ret);
        return ret;
    }

    while (1) {
        k_msleep(POSITION_UPDATE_INTERVAL_MS);

        position_t pos;
        if (triangulation_solve(&tri_ctx, &pos)) {
            LOG_INF("Position: (%.2f, %.2f) m", (double)pos.x, (double)pos.y);
        }
    }

    return 0;
}
```
